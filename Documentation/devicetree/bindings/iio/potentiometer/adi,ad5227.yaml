## Documentation/devicetree/bindings/iio/potentiometer/adi,ad5227.yaml
```yaml
# SPDX-License-Identifier: (GPL-2.0 OR BSD-2-Clause)
%YAML 1.2
---
$id: http://devicetree.org/schemas/iio/potentiometer/adi,ad5227.yaml#
$schema: http://devicetree.org/meta-schemas/core.yaml#

title: Analog Devices AD5227 digital potentiometer

maintainers:
  - Tim Orling <tim.orling@konsulko.com>

description: |
  Datasheet: https://www.analog.com/media/en/technical-documentation/data-sheets/AD5227.pdf

properties:
  compatible:
    const: adi,ad5227

  reg:
    maxItems: 1

  spi-max-frequency: true

additionalProperties: false

required:
  - compatible
  - reg

examples:
  - |
    spi {
        #address-cells = <1>;
        #size-cells = <0>;

        potentiometer@0 {
            compatible = "adi,ad5227";
            reg = <0>;
            spi-max-frequency = <1000000>;
        };
    };
...
```
